## Documentation/devicetree/bindings/iio/light/avago,apds990x.yaml
```yaml
# SPDX-License-Identifier: (GPL-2.0 OR BSD-2-Clause)
%YAML 1.2
---
$id: http://devicetree.org/schemas/iio/light/avago,apds990x.yaml#
$schema: http://devicetree.org/meta-schemas/core.yaml#

title: Avago APDS990x ambient light and proximity sensor

maintainers:
  - Samu Onkalo <samu.p.onkalo@nokia.com>

description:
  APDS990x is a combined ambient light and proximity sensor. ALS and
  proximity functionality are highly connected. ALS measurement path
  must be running while the proximity functionality is enabled.
  Datasheet at https://docs.broadcom.com/doc/AV02-2867EN

properties:
  compatible:
    const: avago,apds990x

  reg:
    maxItems: 1

  interrupts:
    maxItems: 1

  vdd-supply: true
  vled-supply: true

  avago,pdrive:
    $ref: /schemas/types.yaml#/definitions/uint32
    minimum: 0
    maximum: 3
    description:
      The LED drive current is controlled by a regulated current
      sink on the LDR pin. This feature eliminates the need to use
      a current limiting resistor to control LED current. The LED
      drive current can be configured for 12.5 mA (pdrive = 3),
      25 mA (2), 50 mA (1) or 100 mA (0). For higher LED drive
      requirements, an external P type transistor can be used to
      control the LED current.

  avago,ppcount:
    $ref: /schemas/types.yaml#/definitions/uint32
    minimum: 1
    maximum: 255
    description:
      The number of LED pulses can be programmed to a value of 1 to
      255 pulses as needed. Increasing the number of LED pulses at a
      given current will increase the sensor sensitivity. Sensitivity
      grows by the square root of the number of pulses. Each pulse
      has a 16 mS period.

additionalProperties: false

required:
  - compatible
  - reg
  - interrupts
  - vdd-supply
  - vled-supply
  - avago,pdrive
  - avago,ppcount

examples:
  - |
    #include <dt-bindings/interrupt-controller/irq.h>
    i2c {
        #address-cells = <1>;
        #size-cells = <0>;

        light-sensor@39 {
            compatible = "avago,apds990x";
            reg = <0x39>;

            interrupt-parent = <&gpio>;
            interrupts = <82 IRQ_TYPE_EDGE_RISING>;

            vdd-supply = <&vdd_3v0_proxi>;
            vled-supply = <&vdd_1v8_sen>;

            avago,pdrive = <0>;
            avago,ppcount = <3>;
        };
    };
...
```

## Documentation/devicetree/bindings/media/i2c/ti,lm3560.yaml
```yaml
# SPDX-License-Identifier: (GPL-2.0 OR BSD-2-Clause)
%YAML 1.2
---
$id: http://devicetree.org/schemas/media/i2c/ti,lm3560.yaml#
$schema: http://devicetree.org/meta-schemas/core.yaml#

title: TI LM3560 Synchronous Boost Flash Driver

maintainers:
  - Daniel Jeong <gshark.jeong@gmail.com>
  - Ldd-Mlp <ldd-mlp@list.ti.com>

description: |
  The LM3560 is a 2-MHz fixed frequency synchronous boost
  converter with two 1000-mA constant current drivers for
  high-current white LEDs. The dual highside current sources
  allow for grounded cathode LED operation and can be tied
  together for providing flash currents at up to 2 A through
  a single LED. An adaptive regulation method ensures the
  current for each LED remains in regulation and maximizes
  efficiency.

properties:
  compatible:
    items:
      - enum:
          - ti,lm3559
          - ti,lm3560

  reg:
    maxItems: 1

  enable-gpios:
    maxItems: 1

  ti,peak-current:
    $ref: /schemas/types.yaml#/definitions/uint32
    enum: [0, 0x20, 0x40, 0x60]
    default: 0x60
    description: |
      Peak current can be set to 4 values 1.6A (0x00),
      2.3A (0x20), 3.0A (0x40) and 3.6A (0x60).

  ti,max-flash-timeout:
    $ref: /schemas/types.yaml#/definitions/uint32
    minimum: 32
    maximum: 1024
    default: 1024
    description: |
      Maximum flash timeout in ms with step 32ms.

  '#address-cells':
    const: 1

  '#size-cells':
    const: 0

required:
  - compatible
  - reg
  - '#address-cells'
  - '#size-cells'

patternProperties:
  "^led@[01]$":
    type: object
    description: |
      Properties for a connected LEDs.
    properties:
      reg:
        minimum: 0
        maximum: 1

      ti,max-flash-current:
        $ref: /schemas/types.yaml#/definitions/uint32
        minimum: 62500
        maximum: 1000000
        default: 1000000
        description: |
          Maximum current in flash mode in uA with step 62500uA.

      ti,max-torch-current:
        $ref: /schemas/types.yaml#/definitions/uint32
        minimum: 31250
        maximum: 250000
        default: 250000
        description: |
          Maximum current in tourch mode in uA with step 31250uA.

    required:
      - reg

    additionalProperties: false

additionalProperties: false

examples:
  - |
    i2c {
        #address-cells = <1>;
        #size-cells = <0>;

        flash-led@53 {
            compatible = "ti,lm3559";
            reg = <0x53>;

            enable-gpios = <&gpio 219 GPIO_ACTIVE_HIGH>;

            ti,peak-current = <0>;
            ti,max-flash-timeout = <1024>;

            #address-cells = <1>;
            #size-cells = <0>;

            led@0 {
                reg = <0>;

                ti,max-flash-current = <562500>;
                ti,max-torch-current = <156250>;
            };

            led@1 {
                reg = <1>;

                ti,max-flash-current = <562500>;
                ti,max-torch-current = <156250>;
            };
        };
    };
...
```

## Documentation/devicetree/bindings/mfd/asus-ec.yaml
```yaml
# SPDX-License-Identifier: GPL-2.0
%YAML 1.2
---
$id: http://devicetree.org/schemas/mfd/asus-ec.yaml#
$schema: http://devicetree.org/meta-schemas/core.yaml#

title: ASUS Transformer Pad's Embedded Controller bindings

description:
  This binding describes the Nuvoton NPCE795LA0BX Embedded Controller
  attached to an I2C bus and running firmware that is specific to the
  Asus Transformer device series.

maintainers:
  - Michał Mirosław <mirq-linux@rere.qmqm.pl>
  - Svyatoslav Ryhel <clamor95@gmail.com>

allOf:
  - $ref: power-supply.yaml#

properties:
  compatible:
    oneOf:
      - enum:
          - asus,ec-pad  # Pad part of Asus Transformer
          - asus,ec-dock # Dock part of Asus Transformer
  reg:
    maxItems: 1

  interrupts:
    maxItems: 1

  request-gpio:
    maxItems: 1

  asus,dockram:
    $ref: /schemas/types.yaml#/definitions/phandle
    description:
      I2C device used to read/write embedded controller.

  battery:
    type: object

  charger:
    type: object

  keyboard-ext:
    type: object

  led:
    type: object

  serio:
    type: object

  asus,clear-factory-mode:
    type: boolean
    description: clear Factory Mode bit in EC control register

required:
  - compatible
  - reg
  - interrupts
  - request-gpio
  - asus,dockram

additionalProperties: false

examples:
  - |
    #include <dt-bindings/gpio/gpio.h>
    #include <dt-bindings/interrupt-controller/irq.h>

    i2c {
      #address-cells = <1>;
      #size-cells = <0>;

      embedded-controller@19 {
        compatible = "asus,ec-dock";
        reg = <0x19>;

        interrupt-parent = <&gpio>;
        interrupts = <TEGRA_GPIO(S, 7) IRQ_TYPE_LEVEL_LOW>;

        request-gpio = <&gpio TEGRA_GPIO(Q, 6) GPIO_ACTIVE_LOW>;
        asus,dockram = <&dockram_ec>;

        battery {
          compatible = "asus,ec-battery";
          monitored-battery = <&dock_battery>;
        };

        charger {
          compatible = "asus,ec-charger";
          monitored-battery = <&dock_battery>;
        };

        keyboard-ext {
          compatible = "asus,ec-keys";
        };

        led {
          compatible = "asus,ec-led";
        };

        serio {
          compatible = "asus,ec-kbc";
        };
      };
    };
...
```
